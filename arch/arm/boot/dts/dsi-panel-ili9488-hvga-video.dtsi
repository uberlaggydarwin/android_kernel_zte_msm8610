/* Copyright (c) 2013, The Linux Foundation. All rights reserved.
 *
 * This program is free software; you can redistribute it and/or modify
 * it under the terms of the GNU General Public License version 2 and
 * only version 2 as published by the Free Software Foundation.
 *
 * This program is distributed in the hope that it will be useful,
 * but WITHOUT ANY WARRANTY; without even the implied warranty of
 * MERCHANTABILITY or FITNESS FOR A PARTICULAR PURPOSE.  See the
 * GNU General Public License for more details.
 */

/*---------------------------------------------------------------------------
 * This file is autogenerated file using gcdb parser. Please do not edit it.
 * Update input XML file to add a new entry or update variable in this file
 * VERSION = "1.0"
 *---------------------------------------------------------------------------*/
&mdss_mdp {
	dsi_ili9488_hvga_vid: qcom,mdss_dsi_ili9488_hvga_video {
		qcom,mdss-dsi-panel-name = "ili9488 hvga video mode dsi panel";
		qcom,mdss-dsi-panel-controller = <&mdss_dsi0>;
		qcom,cont-splash-enabled = <1>;
		qcom,mdss-dsi-panel-type = "dsi_video_mode";
		qcom,mdss-dsi-panel-destination = "display_1";
		qcom,mdss-dsi-panel-framerate = <60>;
		qcom,mdss-dsi-virtual-channel-id = <0>;
		qcom,mdss-dsi-stream = <0>;
		qcom,mdss-dsi-panel-width = <320>;
		qcom,mdss-dsi-panel-height = <480>;
		qcom,mdss-dsi-h-front-porch = <20>;//80
		qcom,mdss-dsi-h-back-porch = <8>;//80
		qcom,mdss-dsi-h-pulse-width = <8>;
		qcom,mdss-dsi-h-sync-skew = <0>;
		qcom,mdss-dsi-v-back-porch = <16>;//5PCLK
		qcom,mdss-dsi-v-front-porch = <15>;//5
		qcom,mdss-dsi-v-pulse-width = <2>;//5
		qcom,mdss-dsi-h-left-border = <0>;
		qcom,mdss-dsi-h-right-border = <0>;
		qcom,mdss-dsi-v-top-border = <0>;
		qcom,mdss-dsi-v-bottom-border = <0>;
		qcom,mdss-dsi-bpp = <24>;
		qcom,mdss-dsi-underflow-color = <0xff>;
		qcom,mdss-dsi-border-color = <0>;
		qcom,mdss-dsi-on-command = [
29 01 00 00 00 00 10
		E0 00 08 12 0d 1b 0e 38 87 47 08 0E 0A 19 1b 0F
29 01 00 00 00 00 10
		E1 00 13 18 03 0f 05 2a 24 3b 02 06 03 33 33 0F
29 01 00 00 00 00 03
	  C0 10 10
29 01 00 00 00 00 02
	  C1 41 
29 01 00 00 00 00 04
	 C5 00 30 80
29 01 00 00 00 00 02
	36 08
29 01 00 00 00 00 02
	3A 66
29 01 00 00 00 00 02
	B4 02 	
29 01 00 00 00 00 03
	B6 02 22
29 01 00 00 00 00 02
	E9 00	
29 01 00 00 00 00 05
	F7 A9 51 2C 82
05 01 00 00 96 00 02
	11 00
05 01 00 00 1E 00 02
	29 00
	];
		qcom,mdss-dsi-off-command = [05 01 00 00 1E 00 02 28 00
					05 01 00 00 96 00 02 10 00];
		qcom,mdss-dsi-on-command-state = "dsi_lp_mode";
		qcom,mdss-dsi-off-command-state = "dsi_lp_mode";
		qcom,mdss-dsi-h-sync-pulse = <1>;
		qcom,mdss-dsi-traffic-mode = "non_burst_sync_pulse";   //non_burst_sync_event
		qcom,mdss-dsi-lane-map = "lane_map_1032";
		qcom,mdss-dsi-bllp-eof-power-mode;
		qcom,mdss-dsi-bllp-power-mode;
		qcom,mdss-dsi-lane-0-state;
		qcom,mdss-dsi-panel-timings = [54 10 0a 00 30 35 0f 14 12 03 04 00];
		qcom,mdss-dsi-t-clk-post = <0x1f>;  //04
		qcom,mdss-dsi-t-clk-pre = <0x2b>;   //1B
		qcom,mdss-dsi-bl-min-level = <1>;
		qcom,mdss-dsi-bl-max-level = <255>;
		qcom,mdss-dsi-dma-trigger = "trigger_sw";
		qcom,mdss-dsi-mdp-trigger = "none";
		qcom,mdss-dsi-bl-pmic-control-type = "bl_ctrl_wled";
		qcom,mdss-dsi-reset-sequence = <1 20>, <0 20>, <1 120>;

	};
};
