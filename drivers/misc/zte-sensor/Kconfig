## drivers/misc/zte-sensor/Kconfig
```kconfig
#
# TI's shared transport line discipline and the protocol
# drivers (BT, FM and GPS)
#
menu "ZTE sensors"
config ZTE_SENSORS_ACCEL_LIS3DH
	tristate "accel lis3dh"
	depends on I2C
	select INPUT_POLLDEV
	help
	  If you say yes here, you just support st accel lis3dh

config ZTE_SENSORS_LIGHT_TAOS
	tristate "taos light&proximity sensor tmd2771"
	depends on I2C
	default n
	help
	  Say Y if you want to support tmd2771 light&proximity sensor

config ZTE_SENSORS_COMPASS_AK8963
	tristate "AK8963 compass support"
	depends on I2C
	help
	  If you say yes here you get support for Asahi Kasei's
	  orientation sensor AK8963.

config ZTE_SENSORS_ACCEL_MC3XXX
	tristate "accel mc3xxx"
	depends on I2C
	select INPUT_POLLDEV
	help
	  if you say yes here, you just support st accel mc3xxx

config ZTE_SENSORS_ACCEL_BMA2XX
	tristate "accel bma2xx"
	depends on I2C
	select INPUT_POLLDEV
	help
	  if you say yes here, you just support st accel bma2xx

endmenu
```
